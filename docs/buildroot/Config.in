## docs/buildroot/Config.in
```kconfig
config BR2_PACKAGE_BSP
	bool "bsp"
	depends on BR2_INSTALL_LIBSTDCPP
	depends on BR2_TOOLCHAIN_HAS_THREADS
	depends on !BR2_STATIC_LIBS
	select BR2_PACKAGE_HAS_BSP
	help
	  BSP (Board Support Package) is a lightweight embedded software
	  framework providing hardware abstraction and peripheral drivers.

	  Features:
	  - OSAL: Operating System Abstraction Layer
	  - HAL: Hardware Abstraction Layer (CAN, UART, I2C, SPI)
	  - PCL: Peripheral Configuration Library
	  - PDL: Peripheral Driver Layer

	  https://github.com/wanguo99/bsp

if BR2_PACKAGE_BSP

config BR2_PACKAGE_BSP_SAMPLE_APP
	bool "install sample application"
	default y
	help
	  Install the BSP sample application to /usr/bin/bsp-sample-app

config BR2_PACKAGE_BSP_TESTS
	bool "install unit tests"
	help
	  Build and install the BSP unit test suite to /usr/bin/bsp-unit-test

endif

comment "bsp needs a toolchain w/ C++, threads, dynamic library"
	depends on !BR2_INSTALL_LIBSTDCPP || !BR2_TOOLCHAIN_HAS_THREADS || BR2_STATIC_LIBS
```
